## config/west.yml
```yaml
manifest:
  remotes:
    - name: zmkfirmware
      url-base: https://github.com/zmkfirmware
  projects:
    - name: zmk
      remote: zmkfirmware
      revision: main
      west-commands: scripts/west-commands.yml
  self:
    path: config
```

## zephyr/Kconfig
```kconfig
source "${ZEPHYR_BASE}/../zmk-ads1015-input/Kconfig"
source "${ZEPHYR_BASE}/../zmk-tps43-input/Kconfig"
```

## zmk-ads1015-input/Kconfig
```kconfig
menuconfig ZMK_ADS1015_INPUT
	bool "ADS1015 I2C ADC input driver"
	default y
	depends on I2C
	help
	  Enable the ADS1015 I2C ADC input driver. Reads configured
	  analog channels and emits INPUT_ABS events for use with
	  ZMK's pointing subsystem.

if ZMK_ADS1015_INPUT

config ZMK_ADS1015_INPUT_LOG_LEVEL
	int "Log level"
	default 2
	range 0 4
	help
	  Log level for ADS1015 input driver.
	  0=OFF, 1=ERR, 2=WRN, 3=INF, 4=DBG

endif

menuconfig ZMK_TPS43_INPUT
	bool "TPS43 touchpad input driver"
	depends on I2C
	default n
	help
	  Azoteq TPS43 capacitive touchpad on I2C (addr 0x74).
	  Provides pointer movement, tap-to-click, drag, double-click,
	  and 1-finger edge scroll.

if ZMK_TPS43_INPUT

config ZMK_TPS43_INPUT_INTERVAL_MS
	int "Poll interval (ms)"
	default 5
	range 3 100

config ZMK_TPS43_INPUT_SENSITIVITY_NUM
	int "Pointer sensitivity numerator"
	default 1
	range 1 100

config ZMK_TPS43_INPUT_SENSITIVITY_DENOM
	int "Pointer sensitivity denominator"
	default 2
	range 1 100

config ZMK_TPS43_INPUT_SCROLL_SENS_NUM
	int "Scroll sensitivity numerator"
	default 2
	range 1 100

config ZMK_TPS43_INPUT_SCROLL_SENS_DENOM
	int "Scroll sensitivity denominator"
	default 1
	range 1 100

config ZMK_TPS43_INPUT_INVERT_X
	bool "Invert X axis"
	default n

config ZMK_TPS43_INPUT_INVERT_Y
	bool "Invert Y axis"
	default n

menuconfig ZMK_TPS43_INPUT_TAPDRAG
	bool "Soft-tap FSM (tap, drag, double-click)"
	default y

if ZMK_TPS43_INPUT_TAPDRAG

config ZMK_TPS43_INPUT_TAP_TIMEOUT_MS
	int "Tap detection timeout (ms)"
	default 180
	range 50 500

config ZMK_TPS43_INPUT_DOUBLE_CLICK_TIMEOUT_MS
	int "Double-click re-touch window (ms)"
	default 250
	range 50 500

config ZMK_TPS43_INPUT_DRAGLOCK_ENABLE
	bool "Enable drag lock"
	default n

config ZMK_TPS43_INPUT_DRAGLOCK_TIMEOUT_MS
	int "Drag lock re-touch window (ms)"
	default 300
	range 50 1000

config ZMK_TPS43_INPUT_TAP_MOVE_THRESH
	int "Tap movement threshold (abs counts)"
	default 30
	range 5 500

config ZMK_TPS43_INPUT_SAME_SPOT_THRESH
	int "Re-touch same-spot threshold (abs counts)"
	default 80
	range 5 500

config ZMK_TPS43_INPUT_DROP_GRACE_MS
	int "Drop grace period (ms)"
	default 20
	range 0 200

endif

menuconfig ZMK_TPS43_INPUT_EDGESCROLL
	bool "1-finger edge scroll"
	default n

if ZMK_TPS43_INPUT_EDGESCROLL

config ZMK_TPS43_INPUT_ABS_MAX_X
	int "Touchpad absolute X max"
	default 1024
	range 1 65535

config ZMK_TPS43_INPUT_ABS_MAX_Y
	int "Touchpad absolute Y max"
	default 1024
	range 1 65535

config ZMK_TPS43_INPUT_EDGE_LEFT_PCT
	int "Left edge zone width (%)"
	default 0
	range 0 50

config ZMK_TPS43_INPUT_EDGE_LEFT_AXIS
	int "Left edge axis (0=Y scroll, 1=X scroll)"
	default 1
	range 0 1

config ZMK_TPS43_INPUT_EDGE_LEFT_SPEED_NUM
	int "Left edge speed numerator"
	default 1
	range 1 100

config ZMK_TPS43_INPUT_EDGE_LEFT_SPEED_DENOM
	int "Left edge speed denominator"
	default 10
	range 1 100

config ZMK_TPS43_INPUT_EDGE_LEFT_INVERT
	bool "Left edge invert"
	default n

config ZMK_TPS43_INPUT_EDGE_RIGHT_PCT
	int "Right edge zone width (%)"
	default 15
	range 0 50

config ZMK_TPS43_INPUT_EDGE_RIGHT_AXIS
	int "Right edge axis (0=Y scroll, 1=X scroll)"
	default 0
	range 0 1

config ZMK_TPS43_INPUT_EDGE_RIGHT_SPEED_NUM
	int "Right edge speed numerator"
	default 1
	range 1 100

config ZMK_TPS43_INPUT_EDGE_RIGHT_SPEED_DENOM
	int "Right edge speed denominator"
	default 10
	range 1 100

config ZMK_TPS43_INPUT_EDGE_RIGHT_INVERT
	bool "Right edge invert"
	default n

config ZMK_TPS43_INPUT_EDGE_TOP_PCT
	int "Top edge zone height (%)"
	default 0
	range 0 50

config ZMK_TPS43_INPUT_EDGE_TOP_AXIS
	int "Top edge axis (0=Y scroll, 1=X scroll)"
	default 1
	range 0 1

config ZMK_TPS43_INPUT_EDGE_TOP_SPEED_NUM
	int "Top edge speed numerator"
	default 1
	range 1 100

config ZMK_TPS43_INPUT_EDGE_TOP_SPEED_DENOM
	int "Top edge speed denominator"
	default 10
	range 1 100

config ZMK_TPS43_INPUT_EDGE_TOP_INVERT
	bool "Top edge invert"
	default n

config ZMK_TPS43_INPUT_EDGE_BOTTOM_PCT
	int "Bottom edge zone height (%)"
	default 15
	range 0 50

config ZMK_TPS43_INPUT_EDGE_BOTTOM_AXIS
	int "Bottom edge axis (0=Y scroll, 1=X scroll)"
	default 1
	range 0 1

config ZMK_TPS43_INPUT_EDGE_BOTTOM_SPEED_NUM
	int "Bottom edge speed numerator"
	default 1
	range 1 100

config ZMK_TPS43_INPUT_EDGE_BOTTOM_SPEED_DENOM
	int "Bottom edge speed denominator"
	default 10
	range 1 100

config ZMK_TPS43_INPUT_EDGE_BOTTOM_INVERT
	bool "Bottom edge invert"
	default n

endif

config ZMK_TPS43_INPUT_LOG_LEVEL
	int "Log level"
	default 3
	range 0 4

endif

config ZMK_HID_IO
	bool "Enable HID I/O"
	default n

config ZMK_HID_IO_JOYSTICK
	bool "Enable HID I/O Joystick"
	default n

config ZMK_HID_IO_MOUSE
	bool "Enable HID I/O Mouse"
	default n

config ZMK_HID_IO_OUTPUT
	bool "Enable HID I/O Output"
	default n

config ZMK_HID_IO_VOLUME_KNOB
	bool "Enable HID I/O Volume Knob"
	default n

config ZMK_HID_IO_BLE_JOYSTICK_REPORT_QUEUE_SIZE
	int "Max number of mouse HID reports to queue for sending over BLE"
	default 20

config ZMK_HID_IO_BLE_MOUSE_REPORT_QUEUE_SIZE
	int "Max number of mouse HID reports to queue for sending over BLE"
	default 20

config ZMK_HID_IO_OUTPUT_QUEUE_SIZE
	int "Maximum number of output events to allow queueing from HID"
	default 4

config ZMK_HID_IO_BLE_VOLUME_KNOB_REPORT_QUEUE_SIZE
	int "Max number of volume knob HID reports to queue for sending over BLE"
	default 8

DT_COMPAT_ZMK_INPUT_BEHAVIOR_FWD_TO_HID_IO := zmk,input-behavior-fwd-to-hid-io
config ZMK_INPUT_BEHAVIOR_FWD_TO_HID_IO
	bool
	default $(dt_compat_enabled,$(DT_COMPAT_ZMK_INPUT_BEHAVIOR_FWD_TO_HID_IO))

DT_COMPAT_ZMK_INPUT_PROCESSOR_FWD_TO_HID_IO := zmk,input-processor-fwd-to-hid-io
config ZMK_INPUT_PROCESSOR_FWD_TO_HID_IO
	bool
	default $(dt_compat_enabled,$(DT_COMPAT_ZMK_INPUT_PROCESSOR_FWD_TO_HID_IO))

module = ZMK_HID_IO
module-str = ZMK_HID_IO
source "${ZEPHYR_BASE}/subsys/logging/Kconfig.template.log_config"

DT_COMPAT_ZMK_BEHAVIOR_HID_IO_KEY_PRESS := zmk,behavior-hid-io-key-press

config ZMK_BEHAVIOR_HID_IO_KEY_PRESS
	bool
	default $(dt_compat_enabled,$(DT_COMPAT_ZMK_BEHAVIOR_HID_IO_KEY_PRESS))
```

## zmk-ads1015-input/dts/bindings/zmk,ads1015-input.yaml
```yaml
description: ADS1015 I2C ADC input device (joystick)

compatible: "zmk,ads1015-input"

include: [i2c-device.yaml]

properties:
  label:
    type: string
    required: true
  channel-x:
    type: int
    default: 0
    description: ADC channel for X axis (0-3)
  channel-y:
    type: int
    default: 1
    description: ADC channel for Y axis (0-3)
  update-interval-ms:
    type: int
    default: 3
    description: Polling interval in milliseconds
```

## zmk-ads1015-input/dts/bindings/zmk,tps43-input.yaml
```yaml
description: |
  Azoteq TPS43 capacitive touchpad on I2C.
  Emits INPUT_REL_X / INPUT_REL_Y for pointer movement,
  INPUT_BTN_TOUCH for touch state, and handles tap/drag/scroll
  via the integrated soft-tap FSM and edge-scroll engine.
compatible: "zmk,tps43-input"
include: [i2c-device.yaml]
properties:
  label:
    type: string
    required: true
  update-interval-ms:
    type: int
    default: 5
```

## zmk-tps43-input/Kconfig
```kconfig
menuconfig ZMK_TPS43_INPUT
	bool "TPS43 touchpad input driver"
	depends on I2C
	default n
	help
	  Azoteq TPS43 capacitive touchpad on I2C (addr 0x74).
	  Provides pointer movement, tap-to-click, drag, double-click,
	  and 1-finger edge scroll.

if ZMK_TPS43_INPUT

config ZMK_TPS43_INPUT_INTERVAL_MS
	int "Poll interval (ms)"
	default 5
	range 3 100
	help
	  5ms = 200 Hz. Lower = smoother but more CPU.

config ZMK_TPS43_INPUT_SENSITIVITY_NUM
	int "Pointer sensitivity numerator"
	default 1
	range 1 100

config ZMK_TPS43_INPUT_SENSITIVITY_DENOM
	int "Pointer sensitivity denominator"
	default 2
	range 1 100

config ZMK_TPS43_INPUT_SCROLL_SENS_NUM
	int "Scroll sensitivity numerator"
	default 2
	range 1 100

config ZMK_TPS43_INPUT_SCROLL_SENS_DENOM
	int "Scroll sensitivity denominator"
	default 1
	range 1 100

config ZMK_TPS43_INPUT_INVERT_X
	bool "Invert X axis"
	default n

config ZMK_TPS43_INPUT_INVERT_Y
	bool "Invert Y axis"
	default n

menuconfig ZMK_TPS43_INPUT_TAPDRAG
	bool "Soft-tap FSM (tap, drag, double-click)"
	default y
	help
	  Pure-software tap FSM ported from libinput. Replaces
	  the hardware gesture engine (SFGestureEnable=0 on init).

if ZMK_TPS43_INPUT_TAPDRAG

config ZMK_TPS43_INPUT_TAP_TIMEOUT_MS
	int "Tap detection timeout (ms)"
	default 180
	range 50 500

config ZMK_TPS43_INPUT_DOUBLE_CLICK_TIMEOUT_MS
	int "Double-click re-touch window (ms)"
	default 250
	range 50 500

config ZMK_TPS43_INPUT_DRAGLOCK_ENABLE
	bool "Enable drag lock"
	default n

config ZMK_TPS43_INPUT_DRAGLOCK_TIMEOUT_MS
	int "Drag lock re-touch window (ms)"
	default 300
	range 50 1000
	depends on ZMK_TPS43_INPUT_DRAGLOCK_ENABLE

config ZMK_TPS43_INPUT_TAP_MOVE_THRESH
	int "Tap movement threshold (abs counts)"
	default 30
	range 5 500

config ZMK_TPS43_INPUT_SAME_SPOT_THRESH
	int "Re-touch same-spot threshold (abs counts)"
	default 80
	range 5 500

config ZMK_TPS43_INPUT_DROP_GRACE_MS
	int "Drop grace period (ms)"
	default 20
	range 0 200

endif

menuconfig ZMK_TPS43_INPUT_EDGESCROLL
	bool "1-finger edge scroll"
	default n
	help
	  Scroll by touching an edge zone. Up to 4 configurable
	  edges (L/R/T/B) with per-edge axis, speed, invert.

if ZMK_TPS43_INPUT_EDGESCROLL

config ZMK_TPS43_INPUT_ABS_MAX_X
	int "Touchpad absolute X max"
	default 1024
	range 1 65535

config ZMK_TPS43_INPUT_ABS_MAX_Y
	int "Touchpad absolute Y max"
	default 1024
	range 1 65535

config ZMK_TPS43_INPUT_EDGE_LEFT_PCT
	int "Left edge zone width (%)"
	default 0
	range 0 50

config ZMK_TPS43_INPUT_EDGE_LEFT_AXIS
	int "Left edge axis (0=Y scroll, 1=X scroll)"
	default 1
	range 0 1

config ZMK_TPS43_INPUT_EDGE_LEFT_SPEED_NUM
	int "Left edge speed numerator"
	default 1
	range 1 100

config ZMK_TPS43_INPUT_EDGE_LEFT_SPEED_DENOM
	int "Left edge speed denominator"
	default 10
	range 1 100

config ZMK_TPS43_INPUT_EDGE_LEFT_INVERT
	bool "Left edge invert"
	default n

config ZMK_TPS43_INPUT_EDGE_RIGHT_PCT
	int "Right edge zone width (%)"
	default 15
	range 0 50

config ZMK_TPS43_INPUT_EDGE_RIGHT_AXIS
	int "Right edge axis (0=Y scroll, 1=X scroll)"
	default 0
	range 0 1

config ZMK_TPS43_INPUT_EDGE_RIGHT_SPEED_NUM
	int "Right edge speed numerator"
	default 1
	range 1 100

config ZMK_TPS43_INPUT_EDGE_RIGHT_SPEED_DENOM
	int "Right edge speed denominator"
	default 10
	range 1 100

config ZMK_TPS43_INPUT_EDGE_RIGHT_INVERT
	bool "Right edge invert"
	default n

config ZMK_TPS43_INPUT_EDGE_TOP_PCT
	int "Top edge zone height (%)"
	default 0
	range 0 50

config ZMK_TPS43_INPUT_EDGE_TOP_AXIS
	int "Top edge axis (0=Y scroll, 1=X scroll)"
	default 1
	range 0 1

config ZMK_TPS43_INPUT_EDGE_TOP_SPEED_NUM
	int "Top edge speed numerator"
	default 1
	range 1 100

config ZMK_TPS43_INPUT_EDGE_TOP_SPEED_DENOM
	int "Top edge speed denominator"
	default 10
	range 1 100

config ZMK_TPS43_INPUT_EDGE_TOP_INVERT
	bool "Top edge invert"
	default n

config ZMK_TPS43_INPUT_EDGE_BOTTOM_PCT
	int "Bottom edge zone height (%)"
	default 15
	range 0 50

config ZMK_TPS43_INPUT_EDGE_BOTTOM_AXIS
	int "Bottom edge axis (0=Y scroll, 1=X scroll)"
	default 1
	range 0 1

config ZMK_TPS43_INPUT_EDGE_BOTTOM_SPEED_NUM
	int "Bottom edge speed numerator"
	default 1
	range 1 100

config ZMK_TPS43_INPUT_EDGE_BOTTOM_SPEED_DENOM
	int "Bottom edge speed denominator"
	default 10
	range 1 100

config ZMK_TPS43_INPUT_EDGE_BOTTOM_INVERT
	bool "Bottom edge invert"
	default n

endif

config ZMK_TPS43_INPUT_LOG_LEVEL
	int "Log level"
	default 3
	range 0 4
	help
	  0=OFF, 1=ERR, 2=WRN, 3=INF, 4=DBG.

endif
```
