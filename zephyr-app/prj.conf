## CMakeLists.txt
```
cmake_minimum_required(VERSION 3.20.0)
find_package(Zephyr REQUIRED HINTS $ENV{ZEPHYR_BASE})
project(hello_nicenano)

target_include_directories(app PRIVATE ${CMAKE_CURRENT_SOURCE_DIR}/src)

target_sources(app PRIVATE
    src/main.c
    src/drivers/ads1015.c
    src/drivers/bmi160.c
    src/drivers/tps43.c
    src/drivers/tps43_tapdrag.c
    src/alg/filter.c
    src/alg/calibrate.c
    src/alg/fusion.c
    src/hid/mouse.c
)
```

## Kconfig
```
source "Kconfig.zephyr"

menu "Gyro Mouse Configuration"

config GYRO_MOUSE_ENABLE
	bool "Enable gyro mouse"
	default y
	help
	  Master enable for gyro-controlled mouse cursor.

config GYRO_MOUSE_X_SOURCE
	int "Gyro axis for mouse X (0=X, 1=Y, 2=Z)"
	default 0
	range 0 2
	help
	  0=gyro X, 1=gyro Y, 2=gyro Z.

config GYRO_MOUSE_X_INVERT
	bool "Invert mouse X axis"
	default n

config GYRO_MOUSE_Y_SOURCE
	int "Gyro axis for mouse Y (0=X, 1=Y, 2=Z)"
	default 1
	range 0 2

config GYRO_MOUSE_Y_INVERT
	bool "Invert mouse Y axis"
	default n

menu "Sensor Hardware"
	depends on GYRO_MOUSE_ENABLE

config GYRO_MOUSE_SPI_FREQ
	int "SPI bus frequency (Hz)"
	default 8000000
	range 1000000 8000000

config GYRO_MOUSE_CS1_PIN
	int "Sensor 1 chip-select pin"
	default 31
	range 0 31

config GYRO_MOUSE_CS2_PIN
	int "Sensor 2 chip-select pin"
	default 29
	range 0 31

config GYRO_MOUSE_S1_RANGE
	int "Sensor 1 gyro range (dps)"
	default 500
	range 125 2000
	help
	  Options: 125, 250, 500, 1000, 2000.

config GYRO_MOUSE_S2_RANGE
	int "Sensor 2 gyro range (dps)"
	default 125
	range 125 2000

config GYRO_MOUSE_ODR
	int "Gyro/Accel output data rate (Hz)"
	default 1600
	range 25 1600
	help
	  Options: 25, 50, 100, 200, 400, 800, 1600.

endmenu

menu "Sampling & Timing"
	depends on GYRO_MOUSE_ENABLE

config GYRO_MOUSE_BURST_HIGH
	int "Burst samples/tick for high-range sensor"
	default 16
	range 1 256

config GYRO_MOUSE_BURST_LOW
	int "Burst samples/tick for low-range sensor"
	default 112
	range 1 256

config GYRO_MOUSE_TICK_PERIOD_MS
	int "Main loop period (ms)"
	default 4
	range 1 100
	help
	  4ms = 250Hz, 10ms = 100Hz.

endmenu

menu "Mouse Sensitivity"
	depends on GYRO_MOUSE_ENABLE

config GYRO_MOUSE_SENSITIVITY_NUM
	int "Sensitivity numerator"
	default 1
	range 1 10000
	help
	  Effective sensitivity = NUM / DENOM.  1/1000 = 0.001.

config GYRO_MOUSE_SENSITIVITY_DENOM
	int "Sensitivity denominator"
	default 1000
	range 1 10000

config GYRO_MOUSE_DEADZONE
	int "Accumulation deadzone threshold (x1000)"
	default 500
	range 0 2000
	help
	  500 = 0.5 pixels. Prevents drift from accumulated noise.

endmenu

menu "Filters"
	depends on GYRO_MOUSE_ENABLE

config GYRO_MOUSE_HSSNF_ENABLE
	bool "Enable HSSNF non-linear filter"
	default y

config GYRO_MOUSE_HSSNF_T
	int "HSSNF threshold t (x1000)"
	default 1000
	range 1 2000
	depends on GYRO_MOUSE_HSSNF_ENABLE

config GYRO_MOUSE_HSSNF_K
	int "HSSNF curve k (x1000)"
	default 500
	range 1 999
	depends on GYRO_MOUSE_HSSNF_ENABLE

config GYRO_MOUSE_CROSSFADE_Z
	int "Crossfade ramp_mid z (x1000)"
	default 200
	range 50 450
	help
	  200 = 0.2. Deadzone width in saturation-weighted crossfade.

endmenu

menu "Calibration"
	depends on GYRO_MOUSE_ENABLE

config GYRO_MOUSE_CALIBRATE_ON_BOOT
	bool "Calibrate gyro offsets on every boot"
	default y

config GYRO_MOUSE_CAL_SAMPLES
	int "Calibration sample count"
	default 500
	range 100 5000
	depends on GYRO_MOUSE_CALIBRATE_ON_BOOT

config GYRO_MOUSE_HARDCODED_CAL
	bool "Use hardcoded calibration offsets (skip auto-cal)"
	default n

if GYRO_MOUSE_HARDCODED_CAL

config GYRO_MOUSE_CAL_S1X
	int "Sensor 1 (500dps) gyro X offset"
	default 0
	range -32768 32767
config GYRO_MOUSE_CAL_S1Y
	int "Sensor 1 gyro Y offset"
	default 0
	range -32768 32767
config GYRO_MOUSE_CAL_S1Z
	int "Sensor 1 gyro Z offset"
	default 0
	range -32768 32767
config GYRO_MOUSE_CAL_S2X
	int "Sensor 2 (125dps) gyro X offset"
	default 0
	range -32768 32767
config GYRO_MOUSE_CAL_S2Y
	int "Sensor 2 gyro Y offset"
	default 0
	range -32768 32767
config GYRO_MOUSE_CAL_S2Z
	int "Sensor 2 gyro Z offset"
	default 0
	range -32768 32767

endif

endmenu

menu "Debug"
	depends on GYRO_MOUSE_ENABLE

config GYRO_MOUSE_ADC_DECIMATION
	int "ADC read interval (ticks)"
	default 25
	range 1 1000
	help
	  25 ticks at 250Hz = 10Hz debug serial output.

config GYRO_MOUSE_LED_DECIMATION
	int "LED toggle interval (ticks)"
	default 100
	range 1 10000

config GYRO_MOUSE_DTR_TIMEOUT_MS
	int "DTR serial wait timeout (ms). 0 = boot immediately"
	default 0
	range 0 30000
	help
	  0:   Start HID mouse immediately. Serial debug lost until terminal opens.
	  >0:  Wait up to N ms for a terminal to connect before proceeding.

endmenu

menu "TPS43 Touchpad"

config TPS43_ENABLE
	bool "Enable TPS43 touchpad"
	default y
	help
	  Master enable for Azoteq TPS43 capacitive touchpad on I2C (addr 0x74).

config TPS43_SENSITIVITY_NUM
	int "Touchpad sensitivity numerator"
	default 1
	range 1 100
	depends on TPS43_ENABLE
	help
	  Effective sensitivity = NUM / DENOM. Raw touchpad delta is multiplied
	  by this factor before adding to the mouse accumulator. 1/1 = 1x.

config TPS43_SENSITIVITY_DENOM
	int "Touchpad sensitivity denominator"
	default 1
	range 1 100
	depends on TPS43_ENABLE

config TPS43_SCROLL_SENS_NUM
	int "Scroll sensitivity numerator"
	default 2
	range 1 100
	depends on TPS43_ENABLE
	help
	  Effective scroll sensitivity = NUM / DENOM. 2/1 = 2x.

config TPS43_SCROLL_SENS_DENOM
	int "Scroll sensitivity denominator"
	default 1
	range 1 100
	depends on TPS43_ENABLE

config TPS43_INVERT_X
	bool "Invert touchpad X axis"
	default n
	depends on TPS43_ENABLE

config TPS43_INVERT_Y
	bool "Invert touchpad Y axis"
	default n
	depends on TPS43_ENABLE

config TPS43_TAP_ENABLE
	bool "Enable tap-to-click"
	default y
	depends on TPS43_ENABLE
	help
	  When enabled, a tap gesture on the touchpad sends left mouse button click.

menu "Soft-Tap FSM (Exp13)"
	depends on TPS43_ENABLE

config TPS43_TAPDRAG_ENABLE
	bool "Enable soft-tap FSM (libinput-style)"
	default y
	help
	  Pure-software tap FSM ported from libinput's evdev-mt-touchpad-tap.c.
	  Requires TPS43 gesture engine to be disabled (SFGestureEnable=0) so
	  that FINGER_COUNT stays stable. Replaces CONFIG_TPS43_TAP_ENABLE.

config TPS43_TAP_TIMEOUT_MS
	int "Tap detection timeout (ms)"
	default 180
	range 50 500
	depends on TPS43_TAPDRAG_ENABLE
	help
	  libinput default: 180ms. Maximum finger-down time to qualify as a tap.
	  Longer = more forgiving of slow taps, but finger-down + hold may
	  accidentally trigger a tap on release.

config TPS43_DOUBLE_CLICK_TIMEOUT_MS
	int "Double-click / re-touch window (ms)"
	default 250
	range 50 500
	depends on TPS43_TAPDRAG_ENABLE
	help
	  After a tap, the window during which a second touch is accepted.
	  If the second touch releases quickly (within TAP_TIMEOUT_MS):
	    → double-click.
	  If the second touch holds or moves:
	    → drag start.
	  Longer = more forgiving of slow double-taps, but drag feels
	  delayed. Shorter = snappier but may miss slow double-taps.

config TPS43_DRAGLOCK_ENABLE
	bool "Enable drag lock (lift & re-touch to continue drag)"
	default n
	depends on TPS43_TAPDRAG_ENABLE
	help
	  When enabled, lifting the finger mid-drag keeps the button held
	  for DRAGLOCK_TIMEOUT_MS. Re-touching within that window continues
	  the drag without releasing. Disabled = instant drop on lift.

config TPS43_DRAGLOCK_TIMEOUT_MS
	int "Drag lock re-touch window (ms)"
	default 300
	range 50 1000
	depends on TPS43_TAPDRAG_ENABLE
	help
	  libinput default: 300ms. While dragging, if the finger lifts,
	  this is how long the user has to touch down again to continue
	  dragging without releasing the button.

config TPS43_TAP_MOVE_THRESH
	int "Tap movement threshold (abs counts)"
	default 30
	range 5 500
	depends on TPS43_TAPDRAG_ENABLE
	help
	  libinput default: 1.3mm (~30 TPS43 abs units).
	  Maximum finger movement during a touch for it to still count as a tap.
	  Larger = more tolerant of finger wiggle.

config TPS43_SAME_SPOT_THRESH
	int "Re-touch same-spot threshold (abs counts)"
	default 80
	range 5 500
	depends on TPS43_TAPDRAG_ENABLE
	help
	  How close the re-touch must land to the tap-up position to qualify
	  as a drag continuation (rather than a new tap). Larger = easier to
	  re-arm drag.

config TPS43_DROP_GRACE_MS
	int "Drop grace period (ms)"
	default 20
	range 0 200
	depends on TPS43_TAPDRAG_ENABLE
	help
	  When dragging, the finger may briefly lose contact with the touchpad
	  (transient). This grace period keeps the drag button held while waiting
	  for the finger to return. 0 = disabled (instant drop on release).

endmenu

menu "1-Finger Edge Scroll (Exp15)"
	depends on TPS43_ENABLE

config TPS43_EDGESCROLL_ENABLE
	bool "Enable 1-finger edge scroll"
	default n
	help
	  Right edge → vertical scroll, bottom edge → horizontal scroll.
	  Uses absolute finger position from the TPS43 sensor.

if TPS43_EDGESCROLL_ENABLE

config TPS43_ABS_MAX_X
	int "Touchpad absolute X max value"
	default 1024
	range 1 65535
	help
	  Maximum absolute X value the touchpad can report.

config TPS43_ABS_MAX_Y
	int "Touchpad absolute Y max value"
	default 1024
	range 1 65535
	help
	  Maximum absolute Y value the touchpad can report.

menu "Left Edge"

config TPS43_EDGE_LEFT_PCT
	int "Left edge zone width (%)"
	default 0
	range 0 50
	help
	  0 = disabled.

config TPS43_EDGE_LEFT_AXIS
	int "Scroll axis (0=Y/vertical, 1=X/horizontal)"
	default 1
	range 0 1

config TPS43_EDGE_LEFT_SPEED_NUM
	int "Speed numerator"
	default 1
	range 1 100

config TPS43_EDGE_LEFT_SPEED_DENOM
	int "Speed denominator"
	default 10
	range 1 100

config TPS43_EDGE_LEFT_INVERT
	bool "Invert scroll direction"
	default n

endmenu

menu "Right Edge"

config TPS43_EDGE_RIGHT_PCT
	int "Right edge zone width (%)"
	default 15
	range 0 50
	help
	  0 = disabled.

config TPS43_EDGE_RIGHT_AXIS
	int "Scroll axis (0=Y/vertical, 1=X/horizontal)"
	default 0
	range 0 1

config TPS43_EDGE_RIGHT_SPEED_NUM
	int "Speed numerator"
	default 1
	range 1 100

config TPS43_EDGE_RIGHT_SPEED_DENOM
	int "Speed denominator"
	default 10
	range 1 100

config TPS43_EDGE_RIGHT_INVERT
	bool "Invert scroll direction"
	default n

endmenu

menu "Top Edge"

config TPS43_EDGE_TOP_PCT
	int "Top edge zone height (%)"
	default 0
	range 0 50
	help
	  0 = disabled.

config TPS43_EDGE_TOP_AXIS
	int "Scroll axis (0=Y/vertical, 1=X/horizontal)"
	default 1
	range 0 1

config TPS43_EDGE_TOP_SPEED_NUM
	int "Speed numerator"
	default 1
	range 1 100

config TPS43_EDGE_TOP_SPEED_DENOM
	int "Speed denominator"
	default 10
	range 1 100

config TPS43_EDGE_TOP_INVERT
	bool "Invert scroll direction"
	default n

endmenu

menu "Bottom Edge"

config TPS43_EDGE_BOTTOM_PCT
	int "Bottom edge zone height (%)"
	default 15
	range 0 50
	help
	  0 = disabled.

config TPS43_EDGE_BOTTOM_AXIS
	int "Scroll axis (0=Y/vertical, 1=X/horizontal)"
	default 1
	range 0 1

config TPS43_EDGE_BOTTOM_SPEED_NUM
	int "Speed numerator"
	default 1
	range 1 100

config TPS43_EDGE_BOTTOM_SPEED_DENOM
	int "Speed denominator"
	default 10
	range 1 100

config TPS43_EDGE_BOTTOM_INVERT
	bool "Invert scroll direction"
	default n

endmenu

endif
endmenu

config TPS43_DEBUG
	bool "Print touchpad register dump on every tick"
	default n
	depends on TPS43_ENABLE
	help
	  Prints all 16 register bytes from the TPS43 for debugging.

endmenu

endmenu
```

## prj.conf
```kconfig
CONFIG_USB_DEVICE_STACK=y
CONFIG_USB_DEVICE_HID=y
CONFIG_USB_CDC_ACM=y
CONFIG_SERIAL=y
CONFIG_CONSOLE=y
CONFIG_UART_CONSOLE=y
CONFIG_USB_DEVICE_INITIALIZE_AT_BOOT=n

CONFIG_USB_DEVICE_VID=0x239A
CONFIG_USB_DEVICE_PID=0x00B3
CONFIG_USB_DEVICE_MANUFACTURER="nice!nano"
CONFIG_USB_DEVICE_PRODUCT="Zephyr DualGyro+Touchpad Mouse"
CONFIG_USB_DEVICE_SN="NICENANO-DEV-01"
CONFIG_UART_LINE_CTRL=y

CONFIG_TPS43_TAPDRAG_ENABLE=y
CONFIG_TPS43_EDGESCROLL_ENABLE=y
CONFIG_I2C=y
CONFIG_SPI=y
```

## app.overlay
```dts
&usbd {
	hid0: hid {
		compatible = "zephyr,hid-device";
		protocol-code = "mouse";
		in-report-size = <5>;
		in-polling-period-us = <4000>;
	};
};
```

## src/main.c
```c
#include <zephyr/kernel.h>
#include <zephyr/sys/printk.h>
#include <zephyr/usb/usb_device.h>
#include <zephyr/drivers/uart.h>
#include <zephyr/drivers/gpio.h>
#include <zephyr/drivers/i2c.h>
#include <zephyr/drivers/spi.h>
#include <zephyr/device.h>
#include <stdbool.h>
#include <stdint.h>
#include "alg/filter.h"
#include "hid/mouse.h"
#include "drivers/ads1015.h"
#include "drivers/bmi160.h"
#include "drivers/tps43.h"
#include "drivers/tps43_tapdrag.h"
#include "alg/calibrate.h"
#include "alg/fusion.h"

/* ================================================================
 * Constants
 * ================================================================ */

/* --- CS pins for BMI160 --- */
#define CS1_PIN  CONFIG_GYRO_MOUSE_CS1_PIN
#define CS2_PIN  CONFIG_GYRO_MOUSE_CS2_PIN

/* --- Loop timing --- */
#define TICK_PERIOD_MS  CONFIG_GYRO_MOUSE_TICK_PERIOD_MS
#define ADC_DECIMATION  CONFIG_GYRO_MOUSE_ADC_DECIMATION
#define LED_DECIMATION  CONFIG_GYRO_MOUSE_LED_DECIMATION

/* --- Sensitivity --- */
#define GYRO_SENS  ((float)CONFIG_GYRO_MOUSE_SENSITIVITY_NUM / (float)CONFIG_GYRO_MOUSE_SENSITIVITY_DENOM)

/* --- Deadzone (scaled by 1000 in Kconfig) --- */
#define DEADZONE_THR  (CONFIG_GYRO_MOUSE_DEADZONE / 1000.0f)

/* ================================================================
 * Global state
 * ================================================================ */

static const struct device *i2c_dev;

/* ================================================================
 * Application constants
 * ================================================================ */

#if CONFIG_TPS43_ENABLE
#define TPS43_SENS  ((float)CONFIG_TPS43_SENSITIVITY_NUM / (float)CONFIG_TPS43_SENSITIVITY_DENOM)
#define TPS43_SCROLL_SENS  ((float)CONFIG_TPS43_SCROLL_SENS_NUM / (float)CONFIG_TPS43_SCROLL_SENS_DENOM)

static bool tps43_left_btn;
static bool tps43_left_btn_prev;
static int16_t tps43_dbg_dx;
static int16_t tps43_dbg_dy;
static uint8_t tps43_dbg_fingers;
static uint16_t tps43_dbg_abs_x;
static uint16_t tps43_dbg_abs_y;
static bool tps43_prev_touched;
static bool tps43_edge_scroll_mode;
#endif

/* ================================================================
 * Main
 * ================================================================ */

int main(void)
{
	const struct device *gpio0 = DEVICE_DT_GET(DT_NODELABEL(gpio0));
	gpio_pin_configure(gpio0, 15, GPIO_OUTPUT_ACTIVE);
	gpio_pin_configure(gpio0, CS1_PIN, GPIO_OUTPUT_ACTIVE);
	gpio_pin_configure(gpio0, CS2_PIN, GPIO_OUTPUT_ACTIVE);

	i2c_dev = DEVICE_DT_GET(DT_NODELABEL(i2c0));
	if (!device_is_ready(i2c_dev)) {
		while (1)
			;
	}
	i2c_configure(i2c_dev, I2C_SPEED_SET(I2C_SPEED_FAST));
	ads1015_init(i2c_dev);

	const struct device *spi_dev = DEVICE_DT_GET(DT_NODELABEL(spi1));
	if (!device_is_ready(spi_dev)) {
		while (1)
			;
	}
	bmi160_bus_init(spi_dev, gpio0);

	const struct device *hid_dev = device_get_binding("HID_0");
	if (!hid_dev) {
		while (1)
			;
	}

	mouse_init(hid_dev);
	usb_enable(NULL);

#if CONFIG_GYRO_MOUSE_DTR_TIMEOUT_MS > 0
	{
		const struct device *cdc = DEVICE_DT_GET(DT_NODELABEL(cdc_acm_uart0));
		uint32_t dtr = 0;
		int dtr_polls = CONFIG_GYRO_MOUSE_DTR_TIMEOUT_MS / 100;
		while (!dtr && dtr_polls-- > 0) {
			uart_line_ctrl_get(cdc, UART_LINE_CTRL_DTR, &dtr);
			k_sleep(K_MSEC(100));
		}
	}
#endif

	k_sleep(K_SECONDS(1));

	int adc_addr = ads1015_scan();
	if (!adc_addr) {
		printk("No ADC found\n");
	} else {
		printk("ADC at 0x%02X\n", adc_addr);

		uint16_t sum_lsb = 0;
		for (int i = 0; i < 10; i++) {
			int16_t v = ads1015_read_channel(3);
			sum_lsb += v & 0x0F;
			k_sleep(K_MSEC(20));
		}
		printk(sum_lsb == 0 ? "ADS1015 (12-bit)\n" : "ADS1115 (16-bit)\n");

		ads1015_set_data_rate(ADS1015_RATE_128);
		ads1015_calibrate(2, 32);
		ads1015_calibrate(3, 32);
		printk("Hall sensors calibrated (ch2, ch3) at 128 SPS\n");
	}

#if CONFIG_TPS43_ENABLE
	tps43_init(i2c_dev);
	printk("TPS43 touchpad: %s\n", tps43_found ? "found" : "not found");
	if (tps43_found) {
		tps43_disable_gestures();
	}
#if CONFIG_TPS43_TAPDRAG_ENABLE
	tps43_tapdrag_init();
	printk("TPS43 soft-tap FSM: enabled\n");
#endif
#if CONFIG_TPS43_EDGESCROLL_ENABLE
	{
		uint32_t el = (uint32_t)CONFIG_TPS43_ABS_MAX_X * CONFIG_TPS43_EDGE_LEFT_PCT / 100;
		uint32_t er = (uint32_t)CONFIG_TPS43_ABS_MAX_X * (100 - CONFIG_TPS43_EDGE_RIGHT_PCT) / 100;
		uint32_t et = (uint32_t)CONFIG_TPS43_ABS_MAX_Y * CONFIG_TPS43_EDGE_TOP_PCT / 100;
		uint32_t eb = (uint32_t)CONFIG_TPS43_ABS_MAX_Y * (100 - CONFIG_TPS43_EDGE_BOTTOM_PCT) / 100;
		printk("TPS43 edge scroll: L<%u R>%u T<%u B>%u\n", el, er, et, eb);
	}
#endif
#endif

	bool bmi1 = bmi160_sensor_init(CS1_PIN, S1_GYRO_RANGE_REG);
	bool bmi2 = bmi160_sensor_init(CS2_PIN, S2_GYRO_RANGE_REG);
	printk("BMI160 S1(%ddps)=%d S2(%ddps)=%d\n",
	       CONFIG_GYRO_MOUSE_S1_RANGE, bmi1,
	       CONFIG_GYRO_MOUSE_S2_RANGE, bmi2);

#if CONFIG_GYRO_MOUSE_HARDCODED_CAL
		cal_s1x = CONFIG_GYRO_MOUSE_CAL_S1X;
		cal_s1y = CONFIG_GYRO_MOUSE_CAL_S1Y;
		cal_s1z = CONFIG_GYRO_MOUSE_CAL_S1Z;
		cal_s2x = CONFIG_GYRO_MOUSE_CAL_S2X;
		cal_s2y = CONFIG_GYRO_MOUSE_CAL_S2Y;
		cal_s2z = CONFIG_GYRO_MOUSE_CAL_S2Z;
		printk("Using hardcoded gyro calibration\n");
#elif CONFIG_GYRO_MOUSE_CALIBRATE_ON_BOOT
		calibrate_gyro();
#else
		printk("Gyro calibration disabled, using zero offsets\n");
#endif

	printk("Exp15: Dual-gyro HID mouse + TPS43 soft-tap FSM + edge scroll at 250Hz\n");
	printk("tick\tFX\tFY\tFZ\tCH0\tCH1\tCH2_cal\tCH3_cal\tTP_X\tTP_Y\tTP_F\tABS_X\tABS_Y\n");

	int64_t next_tick;
	int tick_count = 0;

	next_tick = k_uptime_get();

	while (1) {
		next_tick += TICK_PERIOD_MS;
		tick_count++;

		float fx = 0, fy = 0, fz = 0;

#if CONFIG_GYRO_MOUSE_ENABLE
		read_fuse_gyro(&fx, &fy, &fz);

		float gyro_v[3] = { fx, fy, fz };
		float mx = gyro_v[CONFIG_GYRO_MOUSE_X_SOURCE];
		float my = gyro_v[CONFIG_GYRO_MOUSE_Y_SOURCE];
#if CONFIG_GYRO_MOUSE_X_INVERT
		mx = -mx;
#endif
#if CONFIG_GYRO_MOUSE_Y_INVERT
		my = -my;
#endif

		mouse_acc_x += apply_hssnf(mx * GYRO_SENS);
		mouse_acc_y += apply_hssnf(my * GYRO_SENS);

		if (DEADZONE_THR > 0.0f) {
			if (fast_fabs(mouse_acc_x) < DEADZONE_THR) mouse_acc_x = 0.0f;
			if (fast_fabs(mouse_acc_y) < DEADZONE_THR) mouse_acc_y = 0.0f;
		}
#endif

#if CONFIG_TPS43_ENABLE
		{
			int16_t tdx = 0, tdy = 0;
			bool tap = false;
			bool touched = tps43_poll(&tdx, &tdy, &tap);
			tps43_dbg_dx = tdx;
			tps43_dbg_dy = tdy;
			uint8_t fingers = tps43_regs[TPS43_FINGER_COUNT - TPS43_GESTURE0];
			tps43_dbg_fingers = touched ? fingers : 0;

			/* Absolute position (always read from registers; persists after lift) */
			uint16_t abs_x = ((uint16_t)tps43_regs[TPS43_XABS_HIGH - TPS43_GESTURE0] << 8) |
			                  tps43_regs[TPS43_XABS_LOW  - TPS43_GESTURE0];
			uint16_t abs_y = ((uint16_t)tps43_regs[TPS43_YABS_HIGH - TPS43_GESTURE0] << 8) |
			                  tps43_regs[TPS43_YABS_LOW  - TPS43_GESTURE0];
			tps43_dbg_abs_x = abs_x;
			tps43_dbg_abs_y = abs_y;

			if (touched) {
#if CONFIG_TPS43_EDGESCROLL_ENABLE
				uint32_t el = (uint32_t)CONFIG_TPS43_ABS_MAX_X * CONFIG_TPS43_EDGE_LEFT_PCT / 100;
				uint32_t er = (uint32_t)CONFIG_TPS43_ABS_MAX_X * (100 - CONFIG_TPS43_EDGE_RIGHT_PCT) / 100;
				uint32_t et = (uint32_t)CONFIG_TPS43_ABS_MAX_Y * CONFIG_TPS43_EDGE_TOP_PCT / 100;
				uint32_t eb = (uint32_t)CONFIG_TPS43_ABS_MAX_Y * (100 - CONFIG_TPS43_EDGE_BOTTOM_PCT) / 100;

				if (touched && !tps43_prev_touched) {
					tps43_edge_scroll_mode =
						(CONFIG_TPS43_EDGE_LEFT_PCT > 0 && abs_x < el) ||
						(CONFIG_TPS43_EDGE_RIGHT_PCT > 0 && abs_x > er) ||
						(CONFIG_TPS43_EDGE_TOP_PCT > 0 && abs_y < et) ||
						(CONFIG_TPS43_EDGE_BOTTOM_PCT > 0 && abs_y > eb);
				}

				if (tps43_edge_scroll_mode) {
					float sv = (float)tdy;
					float sh = (float)tdx;

#define EDGE_SPEED(pct, th, num, denom) \
	if (pct > 0 && th) { \
		float _s = (float)num / (float)denom; \
		sv *= _s; sh *= _s; \
	}

					EDGE_SPEED(CONFIG_TPS43_EDGE_LEFT_PCT,   abs_x < el, CONFIG_TPS43_EDGE_LEFT_SPEED_NUM,   CONFIG_TPS43_EDGE_LEFT_SPEED_DENOM)
					EDGE_SPEED(CONFIG_TPS43_EDGE_RIGHT_PCT,  abs_x > er, CONFIG_TPS43_EDGE_RIGHT_SPEED_NUM,  CONFIG_TPS43_EDGE_RIGHT_SPEED_DENOM)
					EDGE_SPEED(CONFIG_TPS43_EDGE_TOP_PCT,    abs_y < et, CONFIG_TPS43_EDGE_TOP_SPEED_NUM,   CONFIG_TPS43_EDGE_TOP_SPEED_DENOM)
					EDGE_SPEED(CONFIG_TPS43_EDGE_BOTTOM_PCT, abs_y > eb, CONFIG_TPS43_EDGE_BOTTOM_SPEED_NUM, CONFIG_TPS43_EDGE_BOTTOM_SPEED_DENOM)

					/* Default speed if not in any active edge zone */
					if (!((CONFIG_TPS43_EDGE_LEFT_PCT > 0 && abs_x < el) ||
					      (CONFIG_TPS43_EDGE_RIGHT_PCT > 0 && abs_x > er) ||
					      (CONFIG_TPS43_EDGE_TOP_PCT > 0 && abs_y < et) ||
					      (CONFIG_TPS43_EDGE_BOTTOM_PCT > 0 && abs_y > eb))) {
						sv *= 0.1f;
						sh *= 0.1f;
					}

#undef EDGE_SPEED

					mouse_wheel   += (int)sv;
					mouse_wheel_h += (int)sh;
				} else {
					float mv_x = (float)tdx * TPS43_SENS;
					float mv_y = (float)tdy * TPS43_SENS;
#if CONFIG_TPS43_INVERT_X
					mv_x = -mv_x;
#endif
#if CONFIG_TPS43_INVERT_Y
					mv_y = -mv_y;
#endif
					mouse_acc_x += mv_x;
					mouse_acc_y += mv_y;
				}
				tps43_prev_touched = touched;
#else
				if (fingers >= 2) {
					mouse_wheel   += (int)((float)tdy * TPS43_SCROLL_SENS);
					mouse_wheel_h += (int)((float)tdx * TPS43_SCROLL_SENS);
				} else {
					float mv_x = (float)tdx * TPS43_SENS;
					float mv_y = (float)tdy * TPS43_SENS;
#if CONFIG_TPS43_INVERT_X
					mv_x = -mv_x;
#endif
#if CONFIG_TPS43_INVERT_Y
					mv_y = -mv_y;
#endif
					mouse_acc_x += mv_x;
					mouse_acc_y += mv_y;
				}
#endif
			}
#if CONFIG_TPS43_EDGESCROLL_ENABLE
			else if (tps43_prev_touched && !touched) {
				tps43_edge_scroll_mode = false;
				tps43_prev_touched = false;
			}
#endif
#if CONFIG_TPS43_TAPDRAG_ENABLE
			{
				bool rc = false;
				bool dc = false;
				uint8_t fg = touched ? fingers : 0;
				tps43_left_btn = tps43_tapdrag_update(touched, fg, abs_x, abs_y, k_uptime_get(), &rc, &dc);

				if (tps43_left_btn != tps43_left_btn_prev) {
					if (tps43_left_btn) {
						mouse_buttons |= 1;
					} else {
						mouse_buttons &= ~1;
					}
					tps43_left_btn_prev = tps43_left_btn;
					printk("BTN_L: %s @%llu\n", tps43_left_btn ? "DOWN" : "UP", k_uptime_get());
				}
				if (rc) {
					printk("BTN_R: CLICK @%llu\n", k_uptime_get());
					mouse_buttons |= 2;
					send_mouse_report(0, 0, 0, 0);
					mouse_buttons &= ~2;
					send_mouse_report(0, 0, 0, 0);
				}
				if (dc) {
					printk("BTN_L: DOUBLE_CLICK @%llu\n", k_uptime_get());
					mouse_buttons |= 1;
					send_mouse_report(0, 0, 0, 0);
					mouse_buttons &= ~1;
					send_mouse_report(0, 0, 0, 0);
					mouse_buttons |= 1;
					send_mouse_report(0, 0, 0, 0);
					mouse_buttons &= ~1;
					send_mouse_report(0, 0, 0, 0);
				}

			}
#elif CONFIG_TPS43_TAP_ENABLE
			tps43_left_btn = tap;
			if (tps43_left_btn != tps43_left_btn_prev) {
				if (tps43_left_btn) {
					mouse_buttons |= 1;
				} else {
					mouse_buttons &= ~1;
				}
				tps43_left_btn_prev = tps43_left_btn;
			}
#endif
		}
#endif

		int dx = (int)mouse_acc_x;
		int dy = (int)mouse_acc_y;
		mouse_acc_x -= (float)dx;
		mouse_acc_y -= (float)dy;

		if (dx > 127) dx = 127;
		if (dx < -128) dx = -128;
		if (dy > 127) dy = 127;
		if (dy < -128) dy = -128;

		int w = mouse_wheel;
		if (w > 127) w = 127;
		if (w < -128) w = -128;
		mouse_wheel -= w;

		int wh = mouse_wheel_h;
		if (wh > 127) wh = 127;
		if (wh < -128) wh = -128;
		mouse_wheel_h -= wh;

		send_mouse_report((int8_t)dx, (int8_t)dy, (int8_t)w, (int8_t)wh);

		if (tick_count % ADC_DECIMATION == 0) {
			int16_t ch0 = ads1015_read_channel(0);
			int16_t ch1 = ads1015_read_channel(1);
			int16_t ch2 = ads1015_read_calibrated(2);
			int16_t ch3 = ads1015_read_calibrated(3);
			printk("%d\t%d\t%d\t%d\t%d\t%d\t%d\t%d\t%d\t%d\t%d\t%d\t%d\t%d\t%d\t%d\n",
			       tick_count, (int)fx, (int)fy, (int)fz,
			       ch0, ch1, ch2, ch3,
#if CONFIG_TPS43_ENABLE
			       tps43_dbg_dx, tps43_dbg_dy, tps43_dbg_fingers,
			       mouse_buttons, dx, dy,
			       tps43_dbg_abs_x, tps43_dbg_abs_y
#else
			       0, 0, 0, 0, 0, 0, 0, 0
#endif
			       );
		}

		if (tick_count % LED_DECIMATION == 0) {
			gpio_pin_toggle(gpio0, 15);
		}

		int64_t now = k_uptime_get();
		if (next_tick > now) {
			k_sleep(K_MSEC(next_tick - now));
		}
	}

	return 0;
}
```
